## Kconfig
```kconfig
menu "BeShell Configuration"

    menu "Serial Module"

        config BESHELL_SERIAL_USE_UART
            bool "Use UART"
            default y
            help
                Enable the UART interface in the BeShell serial module.

        config BESHELL_SERIAL_USE_I2C
            bool "Use I2C"
            default y
            help
                Enable the I2C interface in the BeShell serial module.

        config BESHELL_SERIAL_I2C_USE_LEGACY
            bool "Use ESP-IDF Legacy I2C Implementation"
            depends on BESHELL_SERIAL_USE_I2C
            default n
            help
                Use ESP-IDF legacy I2C implementation in BeShell.

        config BESHELL_SERIAL_USE_SPI
            bool "Use SPI"
            default y
            help
                Enable the SPI interface in the BeShell serial module.

        config BESHELL_SERIAL_USE_I2S
            bool "Use I2S"
            default y
            help
                Enable the I2S interface in the BeShell serial module.

        config BESHELL_SERIAL_I2S_USE_LEGACY
            bool "Use ESP-IDF Legacy I2S Implementation"
            depends on BESHELL_SERIAL_USE_I2S
            default n
            help
                Use ESP-IDF legacy I2S implementation in BeShell.

    endmenu

    config BESHELL_LOGGER_ENABLE_WRAP
        bool "Enable Logger Module Wrap"
        default n
        help
            Enable the Logger module for BeShell. Allow logger module wrapping write/printf/vprintf.


endmenu
```
